## examples/esp-idf/06_mic_test/components/esp32_s3_touch_lcd_1_85B/Kconfig
```kconfig
menu "ESP32-S3 Touch LCD 1.85B BSP"
    config BSP_LCD_SPI_CLOCK_HZ
        int "LCD QSPI clock (Hz)"
        range 10000000 80000000
        default 80000000
    config BSP_LCD_BUFFER_HEIGHT
        int "LVGL draw buffer height"
        range 10 360
        default 16
    config BSP_LCD_BRIGHTNESS
        int "Initial backlight percentage"
        range 0 100
        default 100
endmenu
```

## examples/esp-idf/06_mic_test/sdkconfig.defaults
```kconfig
CONFIG_IDF_TARGET="esp32s3"
CONFIG_ESPTOOLPY_FLASHMODE_QIO=y
CONFIG_ESPTOOLPY_FLASHSIZE_16MB=y
CONFIG_PARTITION_TABLE_SINGLE_APP_LARGE=y
CONFIG_SPIRAM=y
CONFIG_SPIRAM_MODE_OCT=y
CONFIG_SPIRAM_SPEED_80M=y
CONFIG_SPIRAM_USE_MALLOC=y
CONFIG_SPIRAM_ALLOW_STACK_EXTERNAL_MEMORY=y
CONFIG_ESP_DEFAULT_CPU_FREQ_MHZ_240=y
CONFIG_ESP_MAIN_TASK_STACK_SIZE=8192
CONFIG_FREERTOS_HZ=1000
CONFIG_LV_USE_CLIB_MALLOC=y
CONFIG_LV_USE_CLIB_STRING=y
CONFIG_LV_USE_CLIB_SPRINTF=y
CONFIG_LV_OS_FREERTOS=y
CONFIG_LV_FONT_MONTSERRAT_12=y
CONFIG_LV_FONT_MONTSERRAT_14=y
CONFIG_LV_FONT_MONTSERRAT_16=y
CONFIG_LV_FONT_MONTSERRAT_18=y
CONFIG_LV_FONT_MONTSERRAT_20=y
CONFIG_LV_FONT_MONTSERRAT_22=y
CONFIG_LV_FONT_MONTSERRAT_32=y
CONFIG_CODEC_I2C_BACKWARD_COMPATIBLE=n
CONFIG_BSP_LCD_BUFFER_HEIGHT=16
CONFIG_LV_BUILD_EXAMPLES=n
CONFIG_LV_USE_DEMO_WIDGETS=n
```

## examples/factory/components/Weather/Kconfig
```kconfig
menu "1.85B Weather"
    config S35_WEATHER_API_ID
        string "Weather API ID"
        default "10015813"
    config S35_WEATHER_API_KEY
        string "Weather API key"
        default "070d8d7113bef63bbad7216a89cb00a4"
    config S35_WEATHER_PROVINCE
        string "Province sent to API (UTF-8)"
        default "广东"
    config S35_WEATHER_CITY
        string "City sent to API (UTF-8)"
        default "深圳"
    config S35_WEATHER_CITY_LABEL
        string "City display name"
        default "Shenzhen"
endmenu
```
